#include <ESP8266WiFi.h>
#include <ESP8266HTTPClient.h>
#include <WiFiClient.h>
#include <ArduinoJson.h>
#include <SPI.h>
#include <Wire.h>
#include <Adafruit_GFX.h>
#include <Adafruit_SSD1306.h>

#define SCREEN_WIDTH 128 // OLED display width, in pixels
#define SCREEN_HEIGHT 64 // OLED display height, in pixels

#define OLED_RESET     -1 // Reset pin # (or -1 if sharing Arduino reset pin)
Adafruit_SSD1306 display(SCREEN_WIDTH, SCREEN_HEIGHT, &Wire, OLED_RESET);
  
const char*  ssid = "YOUR_WIFI_SSID";
const char*  password = "YOUR_WIFI_PASSWORD";

WiFiServer server(80);

const unsigned char storm [] PROGMEM {
  0x00, 0x00, 0x00, 0x00, 0x00, 0x00, 0x00, 0x00, 0x00, 0x00, 0x00, 0x00, 0x00, 0x00, 0x00, 0x00, 
  0x00, 0x00, 0x00, 0x00, 0x00, 0x00, 0x00, 0x00, 0x00, 0x00, 0x00, 0x00, 0x00, 0x00, 0x00, 0x00, 
  0x00, 0x00, 0x00, 0x00, 0x00, 0x00, 0x00, 0x00, 0x00, 0x00, 0x00, 0x3f, 0x00, 0x00, 0x00, 0x00, 
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  0x00, 0x00, 0x00, 0x00, 0x00, 0x00, 0x00, 0x00, 0x00, 0x00, 0x00, 0x00, 0x00, 0x00, 0x00, 0x00
};

const unsigned char overcast [] PROGMEM {
  0x00, 0x00, 0x00, 0x00, 0x00, 0x00, 0x00, 0x00, 0x00, 0x00, 0x00, 0x00, 0x00, 0x00, 0x00, 0x00, 
  0x00, 0x00, 0x00, 0x00, 0x00, 0x00, 0x00, 0x00, 0x00, 0x00, 0x00, 0x00, 0x00, 0x00, 0x00, 0x00, 
  0x00, 0x00, 0x00, 0x00, 0x00, 0x00, 0x00, 0x00, 0x00, 0x00, 0x00, 0x00, 0x00, 0x00, 0x00, 0x00, 
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  0x00, 0x00, 0x00, 0x00, 0x00, 0x00, 0x00, 0x00, 0x00, 0x00, 0x00, 0x00, 0x00, 0x00, 0x00, 0x00
};

const unsigned char partlyCloudy [] PROGMEM {
  0x00, 0x00, 0x00, 0x00, 0x00, 0x00, 0x00, 0x00, 0x00, 0x00, 0x00, 0x00, 0x00, 0x00, 0x00, 0x00, 
  0x00, 0x00, 0x00, 0x00, 0x00, 0x00, 0x00, 0x00, 0x00, 0x00, 0x00, 0x00, 0x00, 0x00, 0x00, 0x00, 
  0x00, 0x00, 0x00, 0x00, 0x00, 0x00, 0x00, 0x00, 0x00, 0x00, 0x00, 0x00, 0x00, 0x00, 0x00, 0x00, 
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  0x00, 0x00, 0x00, 0x00, 0x00, 0x00, 0x00, 0x00, 0x00, 0x00, 0x00, 0x00, 0x00, 0x00, 0x00, 0x00
};

const unsigned char sun [] PROGMEM = {
  0x00, 0x00, 0x00, 0x00, 0x00, 0x00, 0x00, 0x00, 0x00, 0x00, 0x00, 0x00, 0x00, 0x00, 0x00, 0x00, 
  0x00, 0x00, 0x00, 0x00, 0x00, 0x00, 0x00, 0x00, 0x00, 0x00, 0x00, 0x01, 0x80, 0x00, 0x00, 0x00, 
  0x00, 0x00, 0x00, 0x03, 0xc0, 0x00, 0x00, 0x00, 0x00, 0x00, 0x00, 0x03, 0xc0, 0x00, 0x00, 0x00, 
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  0x00, 0x00, 0x00, 0x00, 0x00, 0x00, 0x00, 0x00, 0x00, 0x00, 0x00, 0x00, 0x00, 0x00, 0x00, 0x00
};

const unsigned char rainy [] PROGMEM = {
    0x00, 0x00, 0x00, 0x00, 0x00, 0x00, 0x03, 0xfc, 0x00, 0x00, 0x00, 0x00, 0x00, 0x00, 0x00, 0x00, 
    0x00, 0x00, 0x00, 0x00, 0x00, 0x00, 0x0f, 0xff, 0x80, 0x00, 0x00, 0x00, 0x00, 0x00, 0x00, 0x00, 
    0x00, 0x00, 0x00, 0x00, 0x00, 0x00, 0x3f, 0xff, 0xc0, 0x00, 0x00, 0x00, 0x00, 0x00, 0x00, 0x00, 
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    0x00, 0x00, 0x00, 0x00, 0x00, 0xc0, 0x00, 0x30, 0x00, 0x0c, 0x00, 0x00, 0x00, 0x00, 0x00, 0x00
    };

void setup() {
  // put your setup code here, to run once:
  Serial.begin(9600);
  WiFi.begin(ssid, password);
  server.begin();
  Serial.println("Board Init!");
 
  while (WiFi.status() != WL_CONNECTED) {
    delay(500);
    Serial.print("..."); 
  } 

  Serial.print("");
  Serial.println(WiFi.localIP());

  // SSD1306_SWITCHCAPVCC = generate display voltage from 3.3V internally
  if(!display.begin(SSD1306_SWITCHCAPVCC, 0x3C)) { 
    Serial.println(F("SSD1306 allocation failed"));
    for(;;); // Don't proceed, loop forever
  }
} 
 
void loop() {
  // put your main code here, to run repeatedly:
  WiFiClient client2 = server.available();
  HTTPClient http;
 
  String jsonResponse;
  String maxTemp;
  String minTemp;
  int weatherCode;
  String weatherState;
  String wind;
  String rain;

  
  String requestURL = "YOUR_API_KEY";
  
    http.begin(client2, requestURL.c_str());
    
    int httpResponseCode = http.GET();

    if (httpResponseCode > 0){
      Serial.println(httpResponseCode);
      String response = http.getString();
      Serial.println(response);
      jsonResponse = response;

      DynamicJsonDocument parsedJson(1024);
      deserializeJson(parsedJson, response);

      Serial.println(String(parsedJson["daily"]["temperature_2m_max"][0]));
      maxTemp = String(parsedJson["daily"]["temperature_2m_max"][0]);
      minTemp = String(parsedJson["daily"]["temperature_2m_min"][0]);
      wind = String(parsedJson["daily"]["windspeed_10m_max"][0]);
      rain = String(parsedJson["daily"]["rain_sum"][0]);
      weatherCode = String(parsedJson["daily"]["weathercode"][0]).toInt();

      if (weatherCode <= 1) {
        weatherState = "sunny";
      } else if (weatherCode == 2 || weatherCode >= 51 && weatherCode < 57) {
        weatherState = "partly cloudy";
      } else if (weatherCode == 3) {
        weatherState = "overcast";
      } else if (weatherCode >= 61 && weatherCode < 95) {
        weatherState = "raining";
      } else if (weatherCode >= 95 && weatherCode < 99) {
        weatherState = "storming";
      } else {
        weatherState = "";
      }
     
    

    http.end();
    //delay(2000);

    display.clearDisplay(); // clear the display buffer
    display.setTextColor(WHITE, BLACK);
    display.setTextSize(1);
    display.setCursor(0, 0);  
    display.println(" Today's Weather");
    display.println(" Thurs 17/11, CBR");
    display.println(" Today it is " + weatherState);
    display.println(" High of: " + maxTemp + "C");
    display.println(" Low of: " + minTemp + "C");
    display.println(" 10% Chance of rain");
    display.println(" Wind: 13km/h");
    display.display();

    delay(6000);

    //Display Image
    
    display.clearDisplay();
    //display.drawBitmap(0, 0, sun, 128, 64, WHITE);
    //display.display();
    
    if (weatherState == "sunny") {
      display.drawBitmap(0, 0, sun, 128, 64, WHITE);
      display.println(weatherState);
      display.println(maxTemp + "C");
      display.display();
    } else if (weatherState == "partly cloudy") {
      display.drawBitmap(0, 0, partlyCloudy, 128, 64, WHITE);
      display.println(weatherState);
      display.println(maxTemp + "C");
      display.display();
    } else if (weatherState == "overcast") {
      display.drawBitmap(0, 0, overcast, 128, 64, WHITE);
      display.println(weatherState);
      display.println(maxTemp + "C");
      display.display();
    } else if (weatherState == "raining") {
      display.drawBitmap(0, 0, rainy, 128, 64, WHITE);
      display.println(weatherState);
      display.println(maxTemp + "C");
      display.display();
    } else {
      display.drawBitmap(0, 0, storm, 128, 64, WHITE);
      display.println(weatherState);
      display.println(maxTemp + "C");
      display.display();
    }

    delay(2000);


}
}
